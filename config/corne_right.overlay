

&i2c0 {
    status = "okay";
    clock-frequency = <I2C_BITRATE_STANDARD>;
    
    nice_view: nice_view@3C {
        compatible = "nice,view";
        reg = <0x3C>;
        label = "NICE_VIEW";
    };
}; 